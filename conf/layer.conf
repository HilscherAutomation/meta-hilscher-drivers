## conf/layer.conf
```bitbake
# We have a conf and classes directory, add to BBPATH
BBPATH := "${BBPATH}:${LAYERDIR}"

# We have a recipes directory, add to BBFILES
BBFILES := "${BBFILES} ${LAYERDIR}/recipes-*/*/*.bb \
            ${LAYERDIR}/recipes-*/*/*.bbappend"

BBFILE_COLLECTIONS += "hilscher-drivers"
BBFILE_PATTERN_hilscher-drivers := "^${LAYERDIR}/"
BBFILE_PRIORITY_hilscher-drivers = "100"

LAYERSERIES_COMPAT_hilscher-drivers = "dunfell"
```
